## config/west.yml
```yaml
manifest:
  remotes:
    - name: zmkfirmware
      url-base: https://github.com/zmkfirmware
    - name: lowprokb
      url-base: https://github.com/LOWPROKB
  projects:
    - name: zmk
      remote: petejohanson
      revision: feat/pointers-move-scroll
      import: app/west.yml
  self:
    path: config
```
